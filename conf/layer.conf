## conf/layer.conf
```bitbake
# We have a conf and classes directory, add to BBPATH
BBPATH .= ":${LAYERDIR}"

# We have recipes-* directories, add to BBFILES
BBFILES += "${LAYERDIR}/recipes-*/*/*.bb \
            ${LAYERDIR}/recipes-*/*/*.bbappend"

BBFILE_COLLECTIONS += "meta-virtualppg"
BBFILE_PATTERN_meta-virtualppg = "^${LAYERDIR}/"
BBFILE_PRIORITY_meta-virtualppg = "6"

LAYERDEPENDS_meta-virtualppg = "core"
LAYERSERIES_COMPAT_meta-virtualppg = "dunfell"
```
